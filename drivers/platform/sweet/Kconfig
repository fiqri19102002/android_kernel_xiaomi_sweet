## drivers/platform/sweet/Kconfig
```kconfig
config MACH_XIAOMI_SWEET
	bool "Xiaomi Redmi Note 10 Pro (Max)"
	depends on ARCH_SDMMAGPIE
	help
	  Support for Xiaomi Redmi Note 10 Pro (Max) codename sweet.
```
